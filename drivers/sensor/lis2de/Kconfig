## drivers/sensor/lis2de/Kconfig
```kconfig
# Copyright (c) 2021 Nordic Semiconductor ASA
# SPDX-License-Identifier: Apache-2.0

config LIS2DE
	bool "lis2de Accelerometer"
	default y
	depends on DT_HAS_ST_LIS2DE_ENABLED
	help
		Enable the lis2de sensor
```

## dts/bindings/sensor/st,lis2de.yaml
```yaml
description: |
  lis2de driver

  TODO: Example definition in devicetree:

    examplesensor {
        compatible = "zephyr,examplesensor";
        input-gpios = <&gpio0 0 (GPIO_PULL_UP | GPIO_ACTIVE_LOW)>;
    };

compatible: "st,lis2de"

include: sensor-device.yaml

properties:
  irq-gpios:
    type: phandle-array
    description: |
      INT1 and (optional) INT2 signal connections. Active high

# TODO: Add others as needed
```
